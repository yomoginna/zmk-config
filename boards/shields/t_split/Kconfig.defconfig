## boards/shields/t_split/Kconfig.defconfig
```kconfig
# Copyright (c) 2020 The ZMK Contributors
# SPDX-License-Identifier: MIT

if SHIELD_T_SPLIT

config ZMK_KEYBOARD_NAME
    default "T Split"

config ZMK_SPLIT_ROLE_CENTRAL
    default y

endif

if SHIELD_T_SPLIT || SHIELD_T_SPLIT

config ZMK_SPLIT
    default y

endif
```

## boards/shields/t_split/Kconfig.shield
```kconfig
# Copyright (c) 2020 The ZMK Contributors
# SPDX-License-Identifier: MIT

config T_SPLIT_LEFT
    def_bool $(shields_list_contains,t_split_left)

config T_SPLIT_RIGHT
    def_bool $(shields_list_contains,t_split_right)
```
